#ifndef WEB_PAGES_H
#define WEB_PAGES_H

#include <pgmspace.h>

const char webComponent[] PROGMEM = R"rawliteral(

<script>
class WebStyles extends HTMLElement {
    connectedCallback() {
        if (!document.getElementById('web-styles')) {
            const style = document.createElement('style');
            style.id = 'web-styles';
            style.textContent = `
                :root {
                    --blue: #0067b6;
                    --blue-dark: #0045a4;
                    --red: #e57373;
                    --red-dark: #d35f5f;
                    --cyan: #66ddcc;
                    --cyan-dark: #55ccbb;
                    --gray: #6c757d;
                    --gray-dark: #6a7690;
                    --gray-light: #f8f9fa;
                    --gray-lighter: #343a40;
                    --white: #fff;
                    --border: #dee2e6;
                    --shadow: 0 4px 12px rgba(0,0,0,0.08);
                    --border-radius: 8px;
                }
                body {
                    background: linear-gradient(90deg, rgba(179,255,253,0.5) 0%, rgba(227,230,255,0.5) 50%, rgba(253,229,245,0.5) 100%);
                    font-family: -apple-system, BlinkMacSystemFont, 'Segoe UI', Roboto, 'Helvetica Neue', Arial, sans-serif;
                    background-color: var(--gray-light);
                    color: var(--gray-lighter);
                    line-height: 1.5;
                    text-align: center;
                    margin: 0;
                }
                .container {
                    max-width: 500px;
                    margin: 32px auto;
                    padding: 24px;
                    background: rgba(255,255,255,0.6);
                    backdrop-filter: blur(10px);
                    -webkit-backdrop-filter: blur(10px);
                    border-radius: 25px;
                    box-shadow: var(--shadow);
                    display: flex;
                    flex-direction: column;
                    align-items: center;
                }
                h1 {
                    color: var(--blue);
                    font-weight: 600;
                    margin: 0 0 18px 0;
                    font-size: 1.5em;
                }
                h3 {
                    color: var(--gray-dark);
                    margin: 18px 0 10px 0;
                }
                label {
                    display: block;
                    margin: 0.8em 0 0.2em;
                    color: var(--blue);
                    font-weight: bold;
                    font-size: 1em;
                    text-align: left;
                }
                input[type=password], input[type=text], [type=file],select{
                    width: 100%;
                    padding: 10px;
                    margin: 10px 0;
                    border: 1px solid var(--border);
                    border-radius: 6px;
                    font-size: 16px;
                    transition: border-color 0.2s, box-shadow 0.2s;
                    background: linear-gradient(135deg, rgba(255,255,255,0.8), rgba(240,248,255,0.8));
                    box-shadow: inset 0 2px 4px rgba(0,0,0,0.1);
                }
                input[type=password]:focus, input[type=text]:focus, [type=file]:focus {
                    outline: none;
                    border-color: var(--blue);
                    box-shadow: 0 0 0 3px rgba(0,123,255,0.15), inset 0 1px 2px rgba(0,0,0,0.1);
                    transform: scale(1.02);
                }
                input[type=password]::placeholder, input[type=text]::placeholder, [type=file]::placeholder {
                    color: var(--gray);
                    font-style: italic;
                    opacity: 0.7;
                }
                button, input[type=submit] {
                    display: flex;
                    align-items: center;
                    justify-content: center;
                    gap: 8px;
                    padding: 12px;
                    border: none;
                    border-radius: var(--border-radius);
                    font-size: 16px;
                    font-weight: 500;
                    cursor: pointer;
                    transition: background-color 0.2s ease, transform 0.1s ease;
                    color: var(--white);
                    text-decoration: none;
                }
                button:hover, input[type=submit]:hover {
                    transform: translateY(-2px);
                }
                button:active, input[type=submit]:active {
                    transform: translateY(0);
                }
                button svg, input[type=submit] svg {
                    vertical-align: middle;
                }
                .btn-blue {
                    background-color: var(--blue);
                }
                .btn-blue:hover {
                    background-color: var(--blue-dark);
                }
                .btn-cyan {
                    background-color: var(--cyan);
                    color: var(--gray-lighter);
                }
                .btn-cyan:hover {
                    background-color: var(--cyan-dark);
                }
                .btn-red {
                    background-color: var(--red);
                }
                .btn-red:hover {
                    background-color: var(--red-dark);
                }
                .btn-gray {
                    background-color: var(--gray);
                }
                .btn-gray:hover {
                    background-color: var(--gray-dark);
                }
                .button-group {
                    display: flex;
                    justify-content: center;
                    gap: 10px;
                    width: 100%;
                    max-width: 340px;
                }
                @media(max-width:800px) {
                    .container {
                        width: 80vw;
                    }
                }
                .loading {
                    display: flex;
                    flex-direction: column;
                    align-items: center;
                    margin-top: 20px;
                }
                .loading.hidden {
                    display: none;
                }
                .spinner {
                    width: 40px;
                    height: 40px;
                    border: 4px solid var(--gray-light);
                    border-top: 4px solid var(--blue);
                    border-radius: 50%;
                    animation: spin 1s linear infinite;
                }
                @keyframes spin {
                    0% { transform: rotate(0deg); }
                    100% { transform: rotate(360deg); }
                }
                .loading p {
                    color: var(--blue);
                    font-weight: 500;
                    margin-top: 10px;
                }
            `;
            document.head.appendChild(style);
        }
    }
}
customElements.define('web-styles', WebStyles);
</script>

)rawliteral";




const char index_html[] PROGMEM = R"rawliteral(

<!DOCTYPE html>
<html>

<head>
    <meta charset='UTF-8'>
    <meta name='viewport' content='width=device-width, initial-scale=1.0'>
    <title>ESP32 配置页面</title>
    <link rel="icon" href="/favicon.ico" type="image/x-icon">
    <style>
        .main-buttons {
            display: grid;
            grid-template-columns: 1fr 1fr;
            gap: 16px;
        }

        .button-row {
            display: flex;
            justify-content: flex-end;
            margin-top: 10px;
        }

        #key-settings-form {
            text-align: left;
            width: 80%;
            display: none;
        }
    </style>
</head>

<body>
    <web-styles></web-styles>
    <div class='container'>
        <h1>ESP32 设置</h1>
        <div class='main-buttons'>
            <button type='button' class='btn-blue' onclick='openCitySearch()'><svg xmlns='http://www.w3.org/2000/svg'
                    width='18' height='18' viewBox='0 0 24 24' fill='none' stroke='currentColor' stroke-width='2'
                    stroke-linecap='round' stroke-linejoin='round'>
                    <circle cx='11' cy='11' r='8'></circle>
                    <line x1='21' y1='21' x2='16.65' y2='16.65'></line>
                </svg><span>搜索城市</span></button>
            <button type='button' class='btn-cyan' onclick="location.href='/ota'
                "><svg xmlns='http://www.w3.org/2000/svg' width='18' height='18' viewBox='0 0 24 24' fill='none'
                    stroke='currentColor' stroke-width='2' stroke-linecap='round' stroke-linejoin='round'>
                    <path d='M21 15v4a2 2 0 0 1-2 2H5a2 2 0 0 1-2-2v-4'></path>
                    <polyline points='17 8 12 3 7 8'></polyline>
                    <line x1='12' y1='3' x2='12' y2='15'></line>
                </svg><span>OTA升级</span></button>
            <button type='button' id='toggle-key-btn' class='btn-gray' onclick='toggleKeySettings()'><svg
                    xmlns='http://www.w3.org/2000/svg' width='18' height='18' viewBox='0 0 24 24' fill='none'
                    stroke='currentColor' stroke-width='2' stroke-linecap='round' stroke-linejoin='round'>
                    <path
                        d='M21 2l-2 2m-7.61 7.61a5.5 5.5 0 1 1-7.778 7.778 5.5 5.5 0 0 1 7.777-7.777zm0 0L15.5 7.5m0 0l3 3L22 7l-3-3m-3.5 3.5L19 4'>
                    </path>
                </svg><span>和风天气密钥</span></button>
            <button type='button' class='btn-red' onclick='exitSettings()'><svg xmlns='http://www.w3.org/2000/svg'
                    width='18' height='18' viewBox='0 0 24 24' fill='none' stroke='currentColor' stroke-width='2'
                    stroke-linecap='round' stroke-linejoin='round'>
                    <path d='M9 21H5a2 2 0 0 1-2-2V5a2 2 0 0 1 2-2h4'></path>
                    <polyline points='16 17 21 12 16 7'></polyline>
                    <line x1='21' y1='12' x2='9' y2='12'></line>
                </svg><span>退出设置</span></button>
        </div>
        <form id='key-settings-form' action='/set' method='GET' style='margin-top: 10px;'>
            <label>和风天气 API Host:</label>
            <input type='text' name='host' id='apiHost' value='' required>

            <label for='kid'>凭据ID:</label>
            <input id='kid' type='text' name='kid' value='' required>

            <label for='project'>项目ID:</label>
            <input id='project' type='text' name='project' value='' required>

            <label for='key'>私钥:</label>
            <input id='key' type='text' name='key' value='' required>
            <div style='display: flex; justify-content: flex-end; align-items: center; gap: 12px; margin-top: 10px;'>
                <span id='key-error' style='color:#e57373; display:none; font-size: 0.98em;'>请完整填写所有字段。</span>
                <button type='button' class='btn-blue' style='width:100px;' onclick='submitKeySettings()'>提交</button>
            </div>
        </form>
    </div>
    <script>
        document.addEventListener('DOMContentLoaded', function () {
            console.log('正在获取预填写数据...');
            fetch('/get_api_info')
                .then(function (response) { return response.json(); })
                .then(function (data) {
                    document.getElementById('apiHost').value = data.apiHost || '';
                    document.getElementById('kid').value = data.kID || '';
                    document.getElementById('project').value = data.projectID || '';
                    document.getElementById('key').value = data.privateKey || '';
                    console.log('预填写数据已加载。');
                })
                .catch(function (error) {
                    console.error('获取预填写数据时出错:', error);
                });
        });

        function submitKeySettings() {
            var apiHost = document.getElementById('apiHost').value.trim();
            var kID = document.getElementById('kid').value.trim();
            var projectID = document.getElementById('project').value.trim();
            var privateKey = document.getElementById('key').value.trim();
            var errorEl = document.getElementById('key-error');
            if (!apiHost || !kID || !projectID || !privateKey) {
                errorEl.style.display = 'block';
                return;
            }
            errorEl.style.display = 'none';

            const body = {
                apiHost: apiHost,
                kID: kID,
                projectID: projectID,
                privateKey: privateKey
            };

            fetch('/set', {
                method: 'POST',
                headers: {
                    'Content-Type': 'application/json'
                },
                body: JSON.stringify(body)
            })
                .then(function (res) { return res.json ? res.json() : res.text(); })
                .then(function (data) {
                    if (data && data.error) {
                        errorEl.textContent = data.error;
                        errorEl.style.display = 'block';
                    } else {
                        alert('保存成功');
                    }
                })
                .catch(function (err) {
                    console.error('请求出错:\n' + err);
                    errorEl.textContent = '提交失败，请稍后重试。';
                    errorEl.style.display = 'block';
                });
        }

        function openCitySearch() {
            window.location.href = '/citysearch';
        }

        function exitSettings() {
            fetch('/exit')
                .then(res => {
                    console.log('响应状态:', res.status);
                    return res.text();
                })
                .then(text => {
                    console.log('响应内容:', text);
                })
                .catch(err => {
                    console.error('请求出错:', err);
                })
                .finally(() => {
                    alert('请手动关闭此页面。');
                    document.body.innerHTML = `
                <div class='container'>
                    <svg width='56' height='56' viewBox='0 0 24 24' fill='none' stroke='#0067b6' stroke-width='2.2' stroke-linecap='round' stroke-linejoin='round' style='margin-bottom: 18px;'>
                        <circle cx='12' cy='12' r='10' fill='#eaf6ff' />
                        <polyline points='8 12.5 11 15.5 16 10.5' stroke='#2ecc71' stroke-width='2.2' fill='none' />
                        <circle cx='12' cy='12' r='10' stroke='#0067b6' stroke-width='2.2' fill='none' />
                    </svg>
                    <h1>设置已完成</h1>
                    <p style='font-size: 1.18em; color: var(--gray-lighter); margin-bottom: 18px;'>请手动关闭此页面</p>
                </div>
                `;
                });
        }

        function toggleKeySettings() {
            var form = document.getElementById('key-settings-form');
            var btn = document.getElementById('toggle-key-btn').querySelector('span');
            if (form.style.display === 'block') {
                form.style.display = 'none';
                btn.textContent = '和风天气密钥';
            }
            else {
                form.style.display = 'block';
                btn.textContent = '收起密钥设置';
            }
        }
    </script>
</body>

</html>

)rawliteral";




const char ota_html[] PROGMEM = R"rawliteral(

<!DOCTYPE html>
<html>

<head>
    <meta charset="UTF-8">
    <meta name="viewport" content="width=device-width, initial-scale=1.0">
    <title>OTA升级</title>
    <link rel="icon" href="/favicon.ico" type="image/x-icon">
    <style>
        .progress {
            width: 100%;
            max-width: 400px;
            height: 40px;
            background: linear-gradient(to right, #e8f4f8, #f0f0f0);
            border-radius: 20px;
            margin: 20px auto 0 auto;
            overflow: hidden;
            box-shadow: inset 0 2px 4px rgba(0, 0, 0, 0.1);
            position: relative;
        }

        .progress-bar {
            height: 100%;
            background: linear-gradient(90deg, var(--blue) 0%, var(--cyan) 100%);
            width: 0%;
            transition: width 0.4s ease;
            text-align: center;
            line-height: 40px;
            color: var(--white);
            font-weight: 600;
            font-size: 15px;
            box-shadow: 0 2px 8px rgba(0, 103, 182, 0.3);
            position: relative;
            overflow: hidden;
        }

        .progress-bar::before {
            content: '';
            position: absolute;
            top: 0;
            left: -100%;
            width: 100%;
            height: 100%;
            background: linear-gradient(90deg, transparent, rgba(255, 255, 255, 0.3), transparent);
            animation: shimmer 2s infinite;
        }

        @keyframes shimmer {
            0% {
                left: -100%;
            }

            100% {
                left: 100%;
            }
        }

        #status {
            margin-top: 16px;
            min-height: 24px;
            color: var(--blue);
            font-size: 1.08em;
        }
    </style>
</head>

<body>
    <web-styles></web-styles>
    <div class="container">
        <button class="btn-red" onclick="goBack()" style="position: absolute; left: 25px; top: 20;">返回</button>

        <h1>OTA固件升级</h1>
        <h3>方式1: 从URL升级</h3>
        <input type="text" id="otaUrl" placeholder="http://yourserver.com/firmware.bin">
        <button class="btn-blue" onclick="startOTAFromURL(event)">开始URL升级</button>
        <br><br>

        <h3>方式2: 上传固件文件</h3>
        <input type="file" id="otaFile" accept=".bin">
        <button class="btn-cyan" onclick="startOTAFromFile()">开始文件升级</button>
        <div class="progress" id="progressBar" style="display:none;">
            <div class="progress-bar" id="progress">0%</div>
        </div>
        <p id="status"></p>
    </div>
    <script>
        var pollInterval = null;
        function goBack() {
            window.location.href = '../';
        }
        function OTASuccess() {
            document.getElementById('status').innerText = '升级成功!设备将重启...';
            setTimeout(function () { 
                alert('请手动关闭此页面。');
                document.body.innerHTML = `
                <div class='container'>
                    <svg width='56' height='56' viewBox='0 0 24 24' fill='none' stroke='#0067b6' stroke-width='2.2' stroke-linecap='round' stroke-linejoin='round' style='margin-bottom: 18px;'>
                        <circle cx='12' cy='12' r='10' fill='#eaf6ff' />
                        <polyline points='8 12.5 11 15.5 16 10.5' stroke='#2ecc71' stroke-width='2.2' fill='none' />
                        <circle cx='12' cy='12' r='10' stroke='#0067b6' stroke-width='2.2' fill='none' />
                    </svg>
                    <h1>OTA已完成</h1>
                    <p style='font-size: 1.18em; color: var(--gray-lighter); margin-bottom: 18px;'>请手动关闭此页面</p>
                </div>
                `;
            }, 2000);
        }

        // 从URL升级
        function startOTAFromURL(event) {
            var url = document.getElementById('otaUrl').value;
            if (!url) { alert('请输入URL'); return; }
            if (!url.startsWith('http://') && !url.startsWith('https://')) {
                url = 'http://' + url;
            }

            var btn = event.target;
            btn.disabled = true;
            document.getElementById('status').innerText = '正在启动 OTA...';
            document.getElementById('progressBar').style.display = 'block';
            fetch('/ota/url?url=' + encodeURIComponent(url))
                .then(r => {
                    if (r.status === 202) {
                        document.getElementById('status').innerText = '正在下载固件...';
                        pollInterval = setInterval(function () {
                            // /ota/progress返回Json的 progress status error对象
                            fetch('/ota/progress')
                                .then(r => r.json())
                                .then(data => {
                                    var pct = data.progress || 0;
                                    document.getElementById('progress').style.width = pct + '%';
                                    document.getElementById('progress').innerText = pct + '%';
                                    if (data.status === 'success') {
                                        clearInterval(pollInterval);
                                        OTASuccess();
                                    } else if (data.status === 'failed') {
                                        clearInterval(pollInterval);
                                        document.getElementById('status').innerText = '升级失败: ' + data.error;
                                        btn.disabled = false;
                                    }
                                })
                                .catch(() => { });
                        }, 500);
                    } else if (!r.ok) {
                        throw new Error('HTTP ' + r.status);
                    }
                })
                .catch(error => {
                    document.getElementById('status').innerText = '启动OTA失败: ' + error.message;
                    btn.disabled = false;
                    document.getElementById('progressBar').style.display = 'none';
                });
        }

        // 从文件升级
        function startOTAFromFile() {
            var file = document.getElementById('otaFile').files[0];
            if (!file) { alert('请选择文件'); return; }

            document.getElementById('progressBar').style.display = 'block';
            document.getElementById('status').innerText = '正在上传固件...';

            var formData = new FormData();
            formData.append('firmware', file);
            var xhr = new XMLHttpRequest();
            xhr.upload.onprogress = function (e) {
                if (e.lengthComputable) {
                    var pct = Math.round((e.loaded / e.total) * 100);
                    document.getElementById('progress').style.width = pct + '%';
                    document.getElementById('progress').innerText = pct + '%';
                }
            };

            xhr.onload = function () {
                if (xhr.status == 200) {
                    var resp = JSON.parse(xhr.responseText);
                    if (resp.success) {
                        OTASuccess();
                    } else {
                        document.getElementById('status').innerText = '升级失败: ' + resp.error;
                    }
                }
                else {
                    document.getElementById('status').innerText = '上传失败: HTTP ' + xhr.status;
                }
            };
            xhr.open('POST', '/ota/upload');
            xhr.send(formData);
        }
    </script>
</body>

</html>

)rawliteral";



const char city_search_html[] PROGMEM = R"rawliteral(

<!DOCTYPE html>
<html>
<head>
    <meta charset="UTF-8">
    <meta name="viewport" content="width=device-width, initial-scale=1.0">
    <title>城市搜索</title>
    <link rel="icon" href="/favicon.ico" type="image/x-icon">
    <style>
        @keyframes shake {
            0% { transform: translateX(0); }
            25% { transform: translateX(-5px); }
            50% { transform: translateX(5px); }
            75% { transform: translateX(-5px); }
            100% { transform: translateX(0); }
        }
        .shake {
            animation: shake 0.5s;
        }
    </style>
</head>
<body>
    <web-styles></web-styles>
    <div class="container" style="position: relative;">
        <button type='button' class='btn-red' onclick="goBack()" style="position: absolute; left: 25px; top: 20;">返回</button>
        <div style="margin-bottom:18px;">
            <h1 style="text-align: center; margin:0;">城市搜索</h1>
        </div>
        <input type="text" name="location" id="locationInput" placeholder="请输入英语城市名或拼音" required style="width: 60%;" oninput="this.value=this.value.replace(/[^a-zA-Z\s]/g,'')">
        <div style='display: flex;flex-direction: column; gap: 16px; width: 35%;'>
            <input type="submit" value="搜索" class='btn-blue' onclick="getCitySerachResult();" />
        </div>
        <div class="loading hidden" id="loadingBox" style="margin-top: 65px;">
            <div class="spinner"></div>
            <p>请求已受理，正在处理...</p>
        </div>
        <div id="resultBox" style="margin-top:24px;"></div>
    </div>
</body>
<script>
    function getCitySerachResult() {
        const location = document.getElementById('locationInput').value.trim();
        const loadingBox = document.getElementById('loadingBox');
        const resultBox = document.getElementById('resultBox');
        resultBox.innerHTML = '';
        if (!location) {
            alert('请输入城市名或拼音');
            return;
        }
        if (!/^[a-zA-Z\s]+$/.test(location)) {
            alert('城市名只能包含英文字母和空格');
            return;
        }
        loadingBox.classList.remove('hidden');
        fetch(`/citysearch_result?location=${encodeURIComponent(location)}`)
            .then(response => handleResponse(response, loadingBox, resultBox, location))
            .catch(() => {
                loadingBox.classList.add('hidden');
                resultBox.innerHTML = '<div style="color:var(--red);">请求失败，请检查网络。</div>';
            });
    }

    function handleResponse(response, loadingBox, resultBox, location) {
        // 首次请求
        if (response.status !== 200 && response.status !== 202) {
            loadingBox.classList.add('hidden');
            response.text().then(msg => {
                const {error} = JSON.parse(msg || '{}');
                resultBox.innerHTML = `<div style='color:var(--red);'>错误：HTTP ${response.status}<br>${error || '请求失败'}</div>`;
            });
            return;
        }

        // 开始轮询
        if (response.status === 202) {
            pollResult(location, loadingBox, resultBox);
            return;
        }
        loadingBox.classList.add('hidden');
        response.json().then(data => processData(data, resultBox)).catch(() => {
            resultBox.innerHTML = '<div style="color:var(--red);">返回数据格式错误。</div>';
        });
    }

    // 处理返回的数据，渲染按钮
    function processData(data, resultBox) {
        if (data.success && Array.isArray(data.results)) {
            let html = "<h2 style='color:var(--blue)'>搜索结果</h2><ul style='list-style:none;padding:0;margin:0;display:grid;grid-template-columns:1fr 1fr;gap:16px;'>";
            data.results.forEach((obj, idx) => {
                const {name = '', adm1 = '', country = '', locid = '', fxlink = ''} = obj;
                const btnId = `setlocbtn_${idx}`;
                html += `<li><button type='button' class='btn-blue' id='${btnId}' onclick="setLocation('${locid}','${btnId}','${name}','${adm1}','${country}','${fxlink}')">${name} (${adm1}, ${country})</button></li>`;
            });
            html += "</ul>";
            resultBox.innerHTML = html;
        } 
        else if (data.success && data.locid && data.cityname) {
            resultBox.innerHTML = `<div style="color:var(--cyan);">设置成功</div><div class="info">LocationID: ${data.locid}</div><div class="info">城市: ${data.cityname}</div>`;
        } 
        else {
            resultBox.innerHTML = `<div style="color:var(--red);">${data.message || '未找到相关城市'}</div>`;
        }
    }

    // 设置选定的城市
    function setLocation(locid, btnId, name, adm1, country, fxlink) {
        const btn = document.getElementById(btnId);
        if (!btn) return;
        btn.disabled = true;
        btn.textContent = '设置中...';
        fetch('/set_location', {
            method: 'POST',
            headers: { 'Content-Type': 'application/x-www-form-urlencoded' },
            body: 'locid=' + encodeURIComponent(locid) + '&fxlink=' + encodeURIComponent(fxlink)
        }).then(res => {
            if (res.ok) {
                document.querySelectorAll('button.btn-blue[id^="setlocbtn_"]').forEach(b => b.outerHTML = '');
                const resultBox = document.getElementById('resultBox');
                resultBox.innerHTML = `<div style='text-align:center; color:var(--cyan-dark); font-size:22px;'>设置成功<br>${name} (${adm1}, ${country})</div>`;
            } 
            else {
                btn.disabled = false;
                btn.textContent = `${name} (${adm1}, ${country})`;
                btn.classList.add('shake');
                setTimeout(() => btn.classList.remove('shake'), 500);
                res.text().then(msg => {
                    const resultBox = document.getElementById('resultBox');
                    const existingError = resultBox.querySelector('.error-msg');
                    if (existingError) existingError.remove();
                    resultBox.insertAdjacentHTML('afterbegin', `<div class='error-msg' style='color:var(--red); font-size:14px; text-align:center; margin-bottom:10px;'>设置失败：${msg || '服务器错误'}</div>`);
                }).catch(() => {
                    const resultBox = document.getElementById('resultBox');
                    const existingError = resultBox.querySelector('.error-msg');
                    if (existingError) existingError.remove();
                    resultBox.insertAdjacentHTML('afterbegin', `<div class='error-msg' style='color:var(--red); font-size:14px; text-align:center; margin-bottom:10px;'>设置失败：服务器错误</div>`);
                });
            }
        })
        .catch(() => {
            btn.disabled = false;
            btn.textContent = `${name} (${adm1}, ${country})`;
            btn.classList.add('shake');
            setTimeout(() => btn.classList.remove('shake'), 500);
            const resultBox = document.getElementById('resultBox');
            const existingError = resultBox.querySelector('.error-msg');
            if (existingError) existingError.remove();
            resultBox.insertAdjacentHTML('afterbegin', `<div class='error-msg' style='color:var(--red); font-size:14px; text-align:center; margin-bottom:10px;'>设置失败：网络错误</div>`);
        });
    }

    // 轮询函数
    function pollResult(location, loadingBox, resultBox, retry = 0) {
        if (retry > 10) {
            loadingBox.classList.add('hidden');
            resultBox.innerHTML = '<div style="color:var(--red);">处理超时，请稍后重试。</div>';
            return;
        }
        setTimeout(() => {
            fetch(`/citysearch_result?location=${encodeURIComponent(location)}&final=1`)
                .then(response => {
                    if (response.status === 202) {
                        pollResult(location, loadingBox, resultBox, retry + 1);
                        return;
                    }
                    loadingBox.classList.add('hidden');
                    if (response.status !== 200) {
                        response.text().then(msg => resultBox.innerHTML = `<div style='color:var(--red);'>错误：HTTP ${response.status}<br>${msg || '请求失败'}</div>`);
                        return;
                    }
                    response.json().then(data => processData(data, resultBox)).catch(() => resultBox.innerHTML = '<div style="color:var(--red);">返回数据格式错误。</div>');
                })
                .catch(() => {
                    loadingBox.classList.add('hidden');
                    resultBox.innerHTML = '<div style="color:var(--red);">请求失败，请检查网络。</div>';
                });
        }, 1200);
    }

    function goBack() {
        window.location.href = '../';
    }
</script>
</html>

)rawliteral";


const unsigned char favicon_ico[] PROGMEM = {
  0x00, 0x00, 0x01, 0x00, 0x01, 0x00, 0x20, 0x20, 0x00, 0x00, 0x01, 0x00,
  0x20, 0x00, 0xa8, 0x10, 0x00, 0x00, 0x16, 0x00, 0x00, 0x00, 0x28, 0x00,
  0x00, 0x00, 0x20, 0x00, 0x00, 0x00, 0x40, 0x00, 0x00, 0x00, 0x01, 0x00,
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  0x00, 0x00
};

const unsigned int favicon_ico_len = 4286;

#endif // WEB_PAGES_H